#include "esp_camera.h"
#include <WiFi.h>

// ================== AYARLAR ==================
const char* ssid = "Redmi Note 9 Pro";
const char* password = "rumeysa1234";

// ================== PİN TANIMLARI ==================
#define PWDN_GPIO_NUM     32
#define RESET_GPIO_NUM    -1
#define XCLK_GPIO_NUM      0
#define SIOD_GPIO_NUM     26
#define SIOC_GPIO_NUM     27
#define Y9_GPIO_NUM       35
#define Y8_GPIO_NUM       34
#define Y7_GPIO_NUM       39
#define Y6_GPIO_NUM       36
#define Y5_GPIO_NUM       21
#define Y4_GPIO_NUM       19
#define Y3_GPIO_NUM       18
#define Y2_GPIO_NUM        5
#define VSYNC_GPIO_NUM    25
#define HREF_GPIO_NUM     23
#define PCLK_GPIO_NUM     22

WiFiServer server(80);

// ================== MODEL AĞIRLIKLARI ==================

// !!!!!!!!!!!!!!!!!!!!!!!!!!!!!!!!!!!!!!!!!!!!!!!!!!!!!!!!!
// PYTHON ÇIKTISINI (W1, B1, W2, B2) TAM BURAYA YAPIŞTIR
// !!!!!!!!!!!!!!!!!!!!!!!!!!!!!!!!!!!!!!!!!!!!!!!!!!!!!!!!!

// ÖRNEK (Senin yapıştıracağın bunun gibi uzun bir şey olacak):
// const float W1[196][20] = { ... };
const float W1[196][20] = {
  {0.05208, 0.08571, 0.02680, -0.15048, -0.11525, 0.11632, -0.01025, 0.01565, 0.14876, -0.16481, -0.03267, -0.03194, 0.09637, 0.11498, 0.10062, -0.04515, -0.04697, -0.05377, -0.04648, -0.13919, },     
  {-0.07980, -0.03742, -0.00614, 0.08841, 0.14480, -0.05226, -0.06253, 0.02735, 0.11363, -0.08948, -0.08806, 0.00387, -0.09560, 0.04690, -0.15861, -0.13577, -0.05819, -0.15362, 0.15654, -0.10720, },   
  {0.02605, -0.04672, -0.10806, 0.13541, -0.41029, -0.17791, 0.04631, 0.40288, -0.01448, -0.07740, 0.17539, 0.21721, -0.33786, 0.27246, 0.23382, -0.01579, 0.18524, 0.03266, 0.17286, 0.05056, },        
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  {-0.00159, -0.16260, -0.00431, -0.04646, -0.05467, -0.13190, 0.00770, 0.14307, 0.13434, 0.10483, -0.15386, 0.13516, 0.15399, -0.05878, 0.05067, 0.07468, -0.10928, 0.16166, 0.14559, -0.05994, },      
};
// const float B1[20] = { ... };
const float _B1[20] = {
0.29226, -0.25540, 0.02767, 0.39057, 0.19592, 0.08381, 0.50055, 0.02999, -0.03365, 0.32085, 0.00278, 0.44300, 0.41044, 0.27316, -0.17483, 0.16725, 0.21714, 0.16889, 0.01125, 0.16157, };

const float W2[20][10] = {
  {0.83439, 0.64489, -0.62018, -0.27929, -1.49983, -0.26433, -0.30685, -0.63115, 0.11806, 0.50209, },
  {0.19642, -1.13345, -2.09269, -1.03536, 0.45769, 0.97930, 0.07675, -0.41773, 0.03124, 0.12168, },
  {-0.25414, -0.30893, -1.17616, 0.83462, -0.18349, -0.43892, -0.19061, 0.39447, -1.40218, 0.17676, },
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  {0.17052, 0.97001, 0.28251, 0.07620, -2.99020, 1.40295, 0.49584, -0.25879, -0.98731, -1.30060, },
};
const float _B2[10] = {
-0.50117, 0.21452, 0.03958, -0.16531, 0.23695, 0.33422, -0.15500, -0.12587, -0.23769, 0.19397, };
// ...

// ================== AI MOTORU (INFERENCE) ==================
float hidden_layer[20];
float output_layer[10];

// ReLU Aktivasyon Fonksiyonu
float relu(float x) {
  return (x > 0) ? x : 0;
}

// Tahmin Fonksiyonu
int predict_digit(uint8_t *image_data) {
  // 1. KATMAN: Giriş (196) -> Gizli (20)
  for (int h = 0; h < 20; h++) {
    hidden_layer[h] = _B1[h]; // Bias ekle
    for (int i = 0; i < 196; i++) {
      // Pikseli 0-1 arasına çekip ağırlıkla çarp
      float pixel = image_data[i] / 255.0;
      hidden_layer[h] += pixel * W1[i][h];
    }
    hidden_layer[h] = relu(hidden_layer[h]); // ReLU
  }

  // 2. KATMAN: Gizli (20) -> Çıkış (10)
  for (int o = 0; o < 10; o++) {
    output_layer[o] = _B2[o]; // Bias ekle
    for (int h = 0; h < 20; h++) {
      output_layer[o] += hidden_layer[h] * W2[h][o];
    }
  }

  // EN YÜKSEK SKORU BUL (Argmax)
  int best_digit = 0;
  float max_score = output_layer[0];
  for (int i = 1; i < 10; i++) {
    Serial.printf("Digit %d Score: %.2f\n", i, output_layer[i]); // Debug için
    if (output_layer[i] > max_score) {
      max_score = output_layer[i];
      best_digit = i;
    }
  }
  return best_digit;
}

// Görüntüyü 14x14'e küçültme (Python ile aynı mantıkta olmalı)
void resize_to_14x14(camera_fb_t *fb, uint8_t *out_buf) {
  // 160x120 -> 14x14 için basit Nearest Neighbor
  float scale_x = fb->width / 14.0;
  float scale_y = fb->height / 14.0;
  
  for(int y=0; y<14; y++){
    for(int x=0; x<14; x++){
      int src_x = (int)(x * scale_x);
      int src_y = (int)(y * scale_y);
      int idx = (src_y * fb->width) + src_x;
      
      // Renkleri ters çevir (MNIST siyah zemin beyaz yazı, kamera tam tersi)
      // Bu yüzden (255 - pixel) yapıyoruz
      out_buf[y*14 + x] = 255 - fb->buf[idx];
    }
  }
}

void setup() {
  Serial.begin(115200);
  Serial.setDebugOutput(false);

  camera_config_t config;
  config.ledc_channel = LEDC_CHANNEL_0;
  config.ledc_timer = LEDC_TIMER_0;
  config.pin_d0 = Y2_GPIO_NUM;
  config.pin_d1 = Y3_GPIO_NUM;
  config.pin_d2 = Y4_GPIO_NUM;
  config.pin_d3 = Y5_GPIO_NUM;
  config.pin_d4 = Y6_GPIO_NUM;
  config.pin_d5 = Y7_GPIO_NUM;
  config.pin_d6 = Y8_GPIO_NUM;
  config.pin_d7 = Y9_GPIO_NUM;
  config.pin_xclk = XCLK_GPIO_NUM;
  config.pin_pclk = PCLK_GPIO_NUM;
  config.pin_vsync = VSYNC_GPIO_NUM;
  config.pin_href = HREF_GPIO_NUM;
  config.pin_sccb_sda = SIOD_GPIO_NUM;
  config.pin_sccb_scl = SIOC_GPIO_NUM;
  config.pin_pwdn = PWDN_GPIO_NUM;
  config.pin_reset = RESET_GPIO_NUM;
  config.xclk_freq_hz = 20000000;
  config.pixel_format = PIXFORMAT_GRAYSCALE; // GRİ
  config.frame_size = FRAMESIZE_QQVGA; // 160x120
  config.fb_count = 1;

  esp_err_t err = esp_camera_init(&config);
  if (err != ESP_OK) return;

  WiFi.begin(ssid, password);
  while (WiFi.status() != WL_CONNECTED) { delay(500); }
  Serial.println("\nIP: ");
  Serial.println(WiFi.localIP());
  server.begin();
}

void loop() {
  WiFiClient client = server.available();
  if (client) {
    client.println("HTTP/1.1 200 OK");
    client.println("Content-Type: multipart/x-mixed-replace; boundary=frame");
    client.println();

    while (client.connected()) {
      camera_fb_t * fb = esp_camera_fb_get();
      if (!fb) break;

      // 1. Resmi Küçült (14x14)
      uint8_t input_image[196]; // 14*14 = 196
      resize_to_14x14(fb, input_image);

      // 2. Tahmin Et (Eğitilmiş Modeli Çalıştır)
      
      
       int digit = predict_digit(input_image);
       Serial.printf(">>> AI TAHMINI: %d <<<\n", digit);

      // 3. Gönder
      client.println("--frame");
      client.println("Content-Type: application/octet-stream");
      client.println("Content-Length: " + String(fb->len));
      client.println();
      client.write(fb->buf, fb->len);
      client.println();
      
      esp_camera_fb_return(fb);
      delay(500);
    }
  }
}